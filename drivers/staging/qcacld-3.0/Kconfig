## drivers/staging/qcacld-3.0/Kconfig
```kconfig
comment "Qualcomm Atheros CLD WLAN module"

config QCA_CLD_WLAN
	bool "Qualcomm Atheros CLD WLAN module"
	default n
	help
	  Add support for the Qualcomm Atheros CLD WLAN module. It is only
	  built into the kernel image, never as a loadable module.

if QCA_CLD_WLAN

config QCA_CLD_WLAN_PROFILE
	string "Configuration profile for Qualcomm Atheros CLD WLAN module"
	default "default"
	help
	  Specify which configuration profile to be used for building
	  this module.

	  Profiles are located at drivers/staging/qcacld-3.0/configs.

endif # QCA_CLD_WLAN
```

## techpack/data/drivers/Kconfig
```kconfig
# SPDX-License-Identifier: GPL-2.0-only
menu "Qualcomm data extensions"

source "techpack/data/drivers/rmnet/Kconfig"

endmenu
```

## techpack/data/drivers/rmnet/Kconfig
```kconfig
# SPDX-License-Identifier: GPL-2.0-only
source "techpack/data/drivers/rmnet/perf/Kconfig"

source "techpack/data/drivers/rmnet/shs/Kconfig"
```
